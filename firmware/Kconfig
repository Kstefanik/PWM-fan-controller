## firmware/Kconfig
```kconfig
# Main application configuration menu
menu "PWM Fan Controller Application"
    menu "Sensor Manager"
        config SENSOR_MGR_STACK_SIZE
            int "Stack size for sensors thread"
            default 1536
            help
              Size of the stack used by the sensor acquisition thread.

        config SENSOR_MGR_PRIORITY
            int "Priority for sensors thread"
            default 3
            help
              RTOS priority for the sensor acquisition thread.
        config SENSOR_POLL_INTERVAL_MS
            int "Sensor polling interval in ms"
            default 1000
        config DEFAULT_TEMP
            int "Default temperature value"
            default 100
    endmenu

    menu "Control Manager"
        config CONTROL_MGR_STACK_SIZE
            int "Stack size for PID/Control thread"
            default 2048
            help
              Size of the stack used by the PID and PWM control thread.

        config CONTROL_MGR_PRIORITY
            int "Priority for PID/Control thread"
            default 2
            help
              RTOS priority for the PID and PWM control thread.
        config DEFAULT_DUTY
            int "Default duty value for PWM signal"
            default 20
    endmenu

    menu "USB Manager"
        config USB_MGR_STACK_SIZE
            int "Stack size for USB communication thread"
            default 1024

        config USB_MGR_PRIORITY
            int "Priority for USB communication thread"
            default 5
        config DEFAULT_TARGET_TEMP
            int "Default target temperature value"
            default 40
    endmenu

    menu "Tachometer Manager"
        config TACHO_MGR_STACK_SIZE
            int "Stack size for tachometer thread"
            default 1536

        config TACHO_MGR_PRIORITY
            int "Priority for tachometer thread"
            default 4

        config TACHO_POLL_INTERVAL_MS
            int "Tachometer reading interval in ms"
            default 1000
        config TACHO_CAPTURE_TIMEOUT_MS
            int "Tachometer pulse capture timeout in ms"
            default 1000
        config DEFAULT_RPM
            int "Default rpm value"
            default 0
    endmenu

    menu "Bus Configuration"
        config ZBUS_QUEUE_SIZE
            int "Queue size of the Zbus subscriber"
            default 10
            help
                Defines the number of messages the Zbus subscriber queue can hold
                before dropping or blocking.
    endmenu

endmenu

# This must remain at the bottom to pull in all standard Zephyr options
source "Kconfig.zephyr"
```
