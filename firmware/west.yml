## firmware/west.yml
```yaml
manifest:
  remotes:
    - name: zephyrproject-rtos
      url-base: https://github.com/zephyrproject-rtos

  projects:
    - name: zephyr
      remote: zephyrproject-rtos
      revision: v4.4.0
      path: zephyr
      import:
        name-allowlist:
          - cmsis
          - cmsis_6
          - hal_stm32
          - segger
          - zcbor
```
